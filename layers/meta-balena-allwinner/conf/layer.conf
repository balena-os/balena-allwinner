## layers/meta-balena-allwinner/conf/layer.conf
```bitbake
BBPATH .= ":${LAYERDIR}"

BBFILES += "${LAYERDIR}/recipes-*/*/*.bb \
            ${LAYERDIR}/recipes-*/*/*.bbappend"

BBFILE_COLLECTIONS += "balena-allwinner"
BBFILE_PATTERN_balena-allwinner := "^${LAYERDIR}/"
BBFILE_PRIORITY_balena-allwinner = "1337"

LAYERSERIES_COMPAT_balena-allwinner = "dunfell"
```

## layers/meta-balena-allwinner/conf/machine/orangepi-plus2.conf
```bitbake
#@TYPE: Machine
#@NAME: Orange Pi Plus 2
#@DESCRIPTION: Machine configuration for the Orange Pi Plus2, based on allwinner H3 CPU http://www.orangepi.org/

require conf/machine/include/sun8i.inc

KERNEL_DEVICETREE = "sun8i-h3-orangepi-plus.dtb"
UBOOT_MACHINE = "orangepi_plus_defconfig"
PREFERRED_VERSION_linux-mainline = "4.17.3"
```

## layers/meta-balena-allwinner/conf/machine/pine64-plus.conf
```bitbake
#@TYPE: Machine
#@NAME: Pine 64+
#@DESCRIPTION: Machine configuration for the Pine A64+, based on allwinner A53 CPU http://www.pine64.org/

require conf/machine/include/sun50i.inc

KERNEL_DEVICETREE = "allwinner/sun50i-a64-pine64-plus.dtb"
UBOOT_MACHINE = "pine64_plus_defconfig"
# This defaults to "Image" in sunxi64.inc but that is too big for balena's boot partition
KERNEL_IMAGETYPE = "Image.gz"
```

## layers/meta-resin-allwinner/conf/layer.conf
```bitbake
BBPATH .= ":${LAYERDIR}"

BBFILES += "${LAYERDIR}/recipes-*/*/*.bb \
            ${LAYERDIR}/recipes-*/*/*.bbappend"

BBFILE_COLLECTIONS += "resin-allwinner"
BBFILE_PATTERN_resin-allwinner := "^${LAYERDIR}/"
BBFILE_PRIORITY_resin-allwinner = "1337"
```

## layers/meta-resin-allwinner/conf/machine/bananapi-m1-plus.conf
```bitbake
#@TYPE: Machine
#@NAME: Bananapi M1+
#@DESCRIPTION: Machine configuration for the Bananapi M1+, based on allwinner A20 CPU http://bananapi.org/

MACHINEOVERRIDES = "bananapi:${MACHINE}"

include conf/machine/bananapi.conf

KERNEL_DEVICETREE = "sun7i-a20-bananapi-m1-plus.dtb"
UBOOT_MACHINE = "bananapi_m1_plus_config"
PREFERRED_VERSION_linux-mainline = "4.14.15"
```

## layers/meta-resin-allwinner/conf/machine/nanopi-neo-air.conf
```bitbake
#@TYPE: Machine
#@NAME: Nanopi Neo Air
#@DESCRIPTION: Machine configuration for the Nanopi Neo Air, based on allwinner H3 CPU http://www.orangepi.org/

require conf/machine/include/sun8i.inc

KERNEL_DEVICETREE = "sun8i-h3-nanopi-neo-air.dtb"
UBOOT_MACHINE = "nanopi-neo-air_defconfig"
DEFAULTTUNE = "cortexa7hf-neon-vfpv4"
```

## layers/meta-resin-allwinner/conf/machine/orange-pi-lite.conf
```bitbake
#@TYPE: Machine
#@NAME: orange-pi-lite
#@DESCRIPTION: Machine configuration for the orange-pi-lite, base on allwinner H3 CPU

require conf/machine/include/sun8i.inc

PREFERRED_VERSION_linux = "4.11.0+git%"
PREFERRED_VERSION_u-boot = "v2017.03%"

KERNEL_DEVICETREE = "sun8i-h3-orangepi-lite.dtb \ 
overlay/sun8i-h3-analog-codec.dtbo \
overlay/sun8i-h3-cir.dtbo \
overlay/sun8i-h3-fixup.scr \
overlay/sun8i-h3-i2c0.dtbo \
overlay/sun8i-h3-i2c1.dtbo \
overlay/sun8i-h3-i2c2.dtbo \
overlay/sun8i-h3-pps-gpio.dtbo \
overlay/sun8i-h3-pwm.dtbo \
overlay/sun8i-h3-spdif-out.dtbo \
overlay/sun8i-h3-spi-add-cs1.dtbo \
overlay/sun8i-h3-spi-jedec-nor.dtbo \
overlay/sun8i-h3-spi-spidev.dtbo \
overlay/sun8i-h3-uart1.dtbo \
overlay/sun8i-h3-uart2.dtbo \
overlay/sun8i-h3-uart3.dtbo \
overlay/sun8i-h3-usbhost0.dtbo \
overlay/sun8i-h3-usbhost2.dtbo \
overlay/sun8i-h3-usbhost3.dtbo \
overlay/sun8i-h3-w1-gpio.dtbo \
"


UBOOT_MACHINE = "orangepi_lite_defconfig"

DEFAULTTUNE = "cortexa7hf-neon-vfpv4"
```

## layers/meta-resin-allwinner/conf/machine/orangepi-plus2e.conf
```bitbake
#@TYPE: Machine
#@NAME: Orange Pi Plus 2e
#@DESCRIPTION: Machine configuration for the Orange Pi Plus2e, based on allwinner H3 CPU http://www.orangepi.org/

require conf/machine/include/sun8i.inc

KERNEL_DEVICETREE = "sun8i-h3-orangepi-plus2e.dtb"
UBOOT_MACHINE = "orangepi_plus2e_defconfig"
PREFERRED_VERSION_linux-mainline = "4.17.3"
```
